## boards/shields/GeaconSolstice/Kconfig.shield
```kconfig
config SHIELD_SOLSTICE_R
    def_bool $(shields_list_contains,Solstice_R)

config SHIELD_SOLSTICE_L
    def_bool $(shields_list_contains,Solstice_L)

config SHIELD_SOLSTICE_US
    def_bool $(shields_list_contains,Solstice_US)

config SHIELD_SOLSTICE_JIS
    def_bool $(shields_list_contains,Solstice_JIS)
```

## config/boards/shields/GeaconSolstice/Kconfig.defconfig
```kconfig
if SHIELD_GEACONSOLSTICE_R
    config ZMK_KEYBOARD_NAME
        default "Solstice_R"

    config ZMK_SPLIT_ROLE_CENTRAL
        default y
endif

if SHIELD_GEACONSOLSTICE_L
    config ZMK_KEYBOARD_NAME
        default "Solstice_L"

    config ZMK_SPLIT
        default y
endif

if SHIELD_GEACONSOLSTICE_L || SHIELD_GEACONSOLSTICE_R
    config ZMK_SPLIT
        default y

    if ZMK_DISPLAY
        config I2C
            default y

        config SSD1306
            default y
    endif # ZMK_DISPLAY

endif
```

## config/boards/shields/GeaconSolstice/Kconfig.shield
```kconfig
config SHIELD_GEACONSOLSTICE_R
    def_bool $(shields_list_contains,Solstice_R)

config SHIELD_GEACONSOLSTICE_L
    def_bool $(shields_list_contains,Solstice_L)
```
